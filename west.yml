## west.yml
```yaml
# Copyright (c) 2021 Nordic Semiconductor ASA
# SPDX-License-Identifier: Apache-2.0

manifest:
  remotes:
    - name: ncs
      url-base: https://github.com/nrsandoval

  projects:
    # TODO: Once west supports sparse checkout, we should use it here.
    - name: nrfxlib
      remote: ncs
      repo-path: sdk-nrfxlib
      revision: nrf70-linux
```
